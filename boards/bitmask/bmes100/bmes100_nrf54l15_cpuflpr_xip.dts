/*
 * Copyright (c) 2025 Generated by Nordic Semiconductor Pin Planner
 * SPDX-License-Identifier: Apache-2.0
 */

#include "bmes100_nrf54l15_cpuflpr.dts"

&cpuflpr_sram {
	reg = <0x2002f000 DT_SIZE_K(68)>;
	ranges = <0x0 0x2002f000 69632>;
};

/dts-v1/;

#include <nordic/nrf54l15_cpuapp.dtsi>
#include "nrf54l15_cpuapp_common.dtsi"

/ {
	compatible = "bitmask,bmes100-nrf54l15-cpuapp";
	model = "Bitmask BMES100 nRF54L15 Application MCU";

	chosen {
		zephyr,code-partition = &slot0_partition;
		zephyr,sram = &cpuapp_sram;
	};
};

/* Include default memory partition configuration file */
#include <vendor/nordic/nrf54l15_cpuapp_partition.dtsi>

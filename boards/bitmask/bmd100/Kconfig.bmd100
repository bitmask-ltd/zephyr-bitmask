## boards/bitmask/bmd100/Kconfig.bmd100
```kconfig
# Copyright (c) 2022 Zephyr Project members and individual contributors
# SPDX-License-Identifier: Apache-2.0

config BOARD_BMD100
	select SOC_NRF5340_CPUAPP_QKAA if BOARD_BMD100_NRF5340_CPUAPP
	select SOC_NRF5340_CPUAPP_QKAA if BOARD_BMD100_NRF5340_CPUAPP_NS
	select SOC_NRF5340_CPUNET_QKAA if BOARD_BMD100_NRF5340_CPUNET
```

## boards/bitmask/bmd100/bmd100_nrf5340_cpuapp_defconfig
```kconfig
# SPDX-License-Identifier: Apache-2.0

# Enable MPU
CONFIG_ARM_MPU=y

# Enable hardware stack protection
CONFIG_HW_STACK_PROTECTION=y

# Enable TrustZone-M
CONFIG_ARM_TRUSTZONE_M=y

# enable GPIO
CONFIG_GPIO=y

# Enable uart driver
CONFIG_SERIAL=y

# enable console
# CONFIG_CONSOLE=y
# CONFIG_UART_CONSOLE=y

# Board Kconfig.defconfig enables USB CDC ACM and should disable USB remote
# wakeup by default. It needs to be disabled here, because the USB nrfx
# driver always overwrites option from Kconfig mentioned above with the
# imply from CONFIG_USB_NRFX.
# CONFIG_USB_DEVICE_REMOTE_WAKEUP=n

# CONFIG_USB_DEVICE_STACK=y
# CONFIG_USB_CDC_ACM=y
```

## boards/bitmask/bmd100/bmd100_nrf5340_cpunet_defconfig
```kconfig
# SPDX-License-Identifier: Apache-2.0

# Enable MPU
CONFIG_ARM_MPU=y

# Enable hardware stack protection
CONFIG_HW_STACK_PROTECTION=y

# Enable GPIO
CONFIG_GPIO=y

# Enable SPI for nRF21540 FEM control
CONFIG_SPI=y

# Set PA gain for nRF21540
CONFIG_BT_CTLR_TX_PWR_ANTENNA=10
CONFIG_MPSL_FEM_NRF21540_TX_GAIN_DB=10
CONFIG_MPSL_FEM_NRF21540_GPIO_SPI=y
```

## boards/bitmask/bmd100/board.yml
```yaml
board:
  name: bmd100
  full_name: BMD100
  vendor: bitmask
  socs:
  - name: 'nrf5340'
    variants:
    - name: 'ns'
      cpucluster: 'cpuapp'
```

## boards/bitmask/bmes100/Kconfig.bmes100
```kconfig
# Copyright (c) 2025 Generated by Nordic Semiconductor Pin Planner
# SPDX-License-Identifier: Apache-2.0

config BOARD_BMES100
	select SOC_NRF54L15_CPUAPP if BOARD_BMES100_NRF54L15_CPUAPP || BOARD_BMES100_NRF54L15_CPUAPP_NS
	select SOC_NRF54L15_CPUFLPR if BOARD_BMES100_NRF54L15_CPUFLPR || \
					    BOARD_BMES100_NRF54L15_CPUFLPR_XIP
```

## boards/bitmask/bmes100/bmes100_nrf54l15_cpuapp_defconfig
```kconfig
# Copyright (c) 2025 Generated by Nordic Semiconductor Pin Planner
# SPDX-License-Identifier: Apache-2.0

# Enable UART driver
CONFIG_SERIAL=y

# Enable console
CONFIG_CONSOLE=y
CONFIG_UART_CONSOLE=y

# Enable GPIO
CONFIG_GPIO=y

# Enable MPU
CONFIG_ARM_MPU=y

# Enable PMIC support
CONFIG_I2C=y
CONFIG_MFD=y
CONFIG_REGULATOR=y
CONFIG_SENSOR=y

CONFIG_SHELL_BACKEND_SERIAL=y
CONFIG_SHELL=y
```

## boards/bitmask/bmes100/bmes100_nrf54l15_cpuapp_ns_defconfig
```kconfig
# Copyright (c) 2025 Generated by Nordic Semiconductor Pin Planner
# SPDX-License-Identifier: Apache-2.0

# Enable MPU
CONFIG_ARM_MPU=y
CONFIG_NULL_POINTER_EXCEPTION_DETECTION_NONE=y

# Enable TrustZone-M
CONFIG_ARM_TRUSTZONE_M=y

# This Board implies building Non-Secure firmware
CONFIG_TRUSTED_EXECUTION_NONSECURE=y

# Use devicetree code partition for TF-M
CONFIG_USE_DT_CODE_PARTITION=y

# Enable UART driver
CONFIG_SERIAL=y

# Enable console
CONFIG_CONSOLE=y
CONFIG_UART_CONSOLE=y

# Enable GPIO
CONFIG_GPIO=y

# Don't enable the cache in the non-secure image as it is a
# secure-only peripheral on 54l
CONFIG_CACHE_MANAGEMENT=n
CONFIG_EXTERNAL_CACHE=n

# Start SYSCOUNTER on driver init
CONFIG_NRF_GRTC_START_SYSCOUNTER=y

# Disable TFM BL2 since it is not supported
CONFIG_TFM_BL2=n

# nRF54L15 TF-M secure UART selection is fixed inside the
# nRF Connect SDK TF-M CMake configuration.
# Nordic Semiconductor Pin Planner cannot override that from generated board files,
# so leave TF-M UART logging disabled in the export.
CONFIG_TFM_LOG_LEVEL_SILENCE=y
CONFIG_TFM_SECURE_UART=n

# The oscillators are configured as secure and cannot be configured
# from the non secure application directly. This needs to be set
# otherwise nrfx will try to configure them, resulting in a bus
# fault.
CONFIG_NRF_SKIP_CLOCK_CONFIG=y

# Enable PMIC support
CONFIG_I2C=y
CONFIG_MFD=y
CONFIG_REGULATOR=y
CONFIG_SENSOR=y
```

## boards/bitmask/bmes100/board.yml
```yaml
board:
  name: bmes100
  full_name: Bitmask BMES100
  vendor: bitmask
  socs:
    - name: nrf54l15
      variants:
        - name: xip
          cpucluster: cpuflpr
        - name: ns
          cpucluster: cpuapp
runners:
  run_once:
    '--recover':
      - runners:
          - nrfjprog
          - nrfutil
        run: first
        groups:
          - boards:
              - bmes100/nrf54l15/cpuapp
              - bmes100/nrf54l15/cpuapp/ns
              - bmes100/nrf54l15/cpuflpr
              - bmes100/nrf54l15/cpuflpr/xip
    '--erase':
      - runners:
          - nrfjprog
          - jlink
          - nrfutil
        run: first
        groups:
          - boards:
              - bmes100/nrf54l15/cpuapp
              - bmes100/nrf54l15/cpuapp/ns
              - bmes100/nrf54l15/cpuflpr
              - bmes100/nrf54l15/cpuflpr/xip
    '--reset':
      - runners:
          - nrfjprog
          - jlink
          - nrfutil
        run: last
        groups:
          - boards:
              - bmes100/nrf54l15/cpuapp
              - bmes100/nrf54l15/cpuapp/ns
              - bmes100/nrf54l15/cpuflpr
              - bmes100/nrf54l15/cpuflpr/xip
```
